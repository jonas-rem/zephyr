## boards/shields/link_board_can/Kconfig.defconfig
```kconfig
# Copyright (c) 2021 Phytec Messtechnik GmbH
# SPDX-License-Identifier: Apache-2.0

if SHIELD_LINK_BOARD_CAN

if CAN

config SPI
	default y

config CAN_MCP25XXFD
	default y

endif # CAN

endif # SHIELD_LINK_BOARD_CAN
```

## boards/shields/link_board_can/Kconfig.shield
```kconfig
# Copyright (c) 2021 Phytec Messtechnik GmbH
# SPDX-License-Identifier: Apache-2.0

config SHIELD_LINK_BOARD_CAN
	def_bool $(shields_list_contains,link_board_can)
```
